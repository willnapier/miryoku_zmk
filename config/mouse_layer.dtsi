// Copyright 2022 Manna Harbour
// https://github.com/manna-harbour/miryoku

&mmv {
  acceleration-exponent = <2>;
  time-to-max-speed-ms = <100>;
  delay-ms = <0>;
};

&msc {
  acceleration-exponent = <3>;
  time-to-max-speed-ms = <100>;
  delay-ms = <0>;
};

u_mouse {
  bindings = <
    // Row 1: top row (5L + 5R)
    &none &none &none &none &none     &none &none &none &none &none

    // Row 2: home row (5L + 5R)
    &mkp BTN1 &mkp BTN2 &mkp BTN3 &mkp BTN1 &none     &none &mmv MOVE_LEFT &mmv MOVE_DOWN &mmv MOVE_UP &mmv MOVE_RIGHT

    // Row 3: bottom row incl. pinky (6L + 6R)
    &none &none &none &none &none &none     &none &msc SCROLL_LEFT &msc SCROLL_DOWN &msc SCROLL_UP &msc SCROLL_RIGHT &none

    // Row 4: thumbs (3L + 3R)
    &none &none &none     &none &none &none
  >;
};
