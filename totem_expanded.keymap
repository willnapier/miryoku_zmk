#line 4 "miryoku/miryoku.dtsi"
#include <behaviors.dtsi>
#include <behaviors/mouse_key_press.dtsi>




#include <dt-bindings/zmk/keys.h>
#include <dt-bindings/zmk/bt.h>
#include <dt-bindings/zmk/rgb.h>
#include <dt-bindings/zmk/outputs.h>
#include <dt-bindings/zmk/ext_power.h>
#line 17 "miryoku/miryoku.dtsi"
#include <dt-bindings/zmk/mouse.h>

/ {
  keymap {
    compatible = "zmk,keymap";
#line 3 "miryoku/miryoku_layers_default.dtsi"
BASE { display-name = "Base"; bindings = < &kp Q  &kp W  &kp F  &kp P  &kp B       &kp J  &kp L  &kp U  &kp Y  &kp SQT &u_mt LGUI A  &u_mt LALT R  &u_mt LCTRL S  &u_mt LSHFT T  &kp G       &kp M  &u_mt LSHFT N  &u_mt LCTRL E  &u_mt LALT I  &u_mt LGUI O &u_lt 3 Z  &u_mt RALT X  &kp C  &kp D  &kp V       &kp K  &kp H  &kp COMMA  &u_mt RALT DOT  &u_lt 3 SLASH &u_lt 6 ESC  &u_lt 4 SPACE  &u_lt 5 TAB       &u_lt 8 RET  &u_lt 7 BSPC  &u_lt 9 DEL >; };
SYM { display-name = "Sym"; bindings = < &kp LBRC  &kp AMPS  &kp ASTRK  &kp LPAR  &kp RBRC       &none  &u_to_U_BASE  &u_to_U_EXTRA  &u_to_U_TAP  &bootloader &kp COLON  &kp DLLR  &kp PRCNT  &kp CARET  &kp PLUS       &none  &kp LSHFT  &kp LCTRL  &kp LALT  &kp LGUI &kp TILDE  &kp EXCL  &kp AT  &kp HASH  &kp PIPE       &none  &u_to_U_SYM  &u_to_U_MOUSE  &kp RALT  &none &kp LPAR  &kp RPAR  &kp UNDER       &none  &none  &none >; };
NUM { display-name = "Num"; bindings = < &kp LBKT  &kp N7  &kp N8  &kp N9  &kp RBKT       &none  &u_to_U_BASE  &u_to_U_EXTRA  &u_to_U_TAP  &bootloader &kp SEMI  &kp N4  &kp N5  &kp N6  &kp EQUAL       &none  &kp LSHFT  &kp LCTRL  &kp LALT  &kp LGUI &kp GRAVE  &kp N1  &kp N2  &kp N3  &kp BSLH       &none  &u_to_U_NUM  &u_to_U_NAV  &kp RALT  &none &kp DOT  &kp N0  &kp MINUS       &none  &none  &none >; };
NAV { display-name = "Nav"; bindings = < &bootloader  &u_to_U_TAP  &u_to_U_EXTRA  &u_to_U_BASE  &none       &kp K_AGAIN  &kp LS(INS)  &kp LC(INS)  &kp LS(DEL)  &kp K_UNDO &kp LGUI  &kp LALT  &kp LCTRL  &kp LSHFT  &none       &u_caps_word  &kp LEFT  &kp DOWN  &kp UP  &kp RIGHT &none  &kp RALT  &u_to_U_NUM  &u_to_U_NAV  &none       &kp INS  &kp HOME  &kp PG_DN  &kp PG_UP  &kp END &none  &none  &none       &kp RET  &kp BSPC  &kp DEL >; };
MEDIA { display-name = "Media"; bindings = < &bootloader  &u_to_U_TAP  &u_to_U_EXTRA  &u_to_U_BASE  &none       &rgb_ug RGB_TOG  &rgb_ug RGB_EFF  &rgb_ug RGB_HUI  &rgb_ug RGB_SAI  &rgb_ug RGB_BRI &kp LGUI  &kp LALT  &kp LCTRL  &kp LSHFT  &none       &ext_power EP_TOG  &kp C_PREV  &kp C_VOL_DN  &kp C_VOL_UP  &kp C_NEXT &none  &kp RALT  &u_to_U_FUN  &u_to_U_MEDIA  &none       &u_out_tog  &u_bt_sel_0  &u_bt_sel_1  &u_bt_sel_2  &u_bt_sel_3 &none  &none  &none       &kp C_STOP  &kp C_PP  &kp C_MUTE >; };
MOUSE { display-name = "Mouse"; bindings = < &mkp MB1  &mkp MB2  &mkp MB3  U_BTN4  U_BTN5       &none  U_MH_LEFT  U_MH_DOWN  U_MH_UP  U_MH_RIGHT &none  U_MW_LEFT  U_MW_DOWN  U_MW_UP  U_MW_RIGHT       &none  &none  &none  &none  &none &none  &none  &none  &none  &none       &none  &none  &none  &none  &none &none  &none  &none       &none  &none  &none >; };
FUN { display-name = "Fun"; bindings = < &kp F12  &kp F7  &kp F8  &kp F9  &kp PSCRN       &none  &u_to_U_BASE  &u_to_U_EXTRA  &u_to_U_TAP  &bootloader &kp F11  &kp F4  &kp F5  &kp F6  &kp SLCK       &none  &kp LSHFT  &kp LCTRL  &kp LALT  &kp LGUI &kp F10  &kp F1  &kp F2  &kp F3  &kp PAUSE_BREAK       &none  &u_to_U_FUN  &u_to_U_MEDIA  &kp RALT  &none &kp K_APP  &kp SPACE  &kp TAB       &none  &none  &none >; };
#line 37 "miryoku/miryoku.dtsi"
  };
};
#line 20 "miryoku/miryoku_shift_functions.dtsi"
/ { macros { u_macro_u_bt_sel_0: u_macro_u_bt_sel_0 { compatible = "zmk,behavior-macro"; #binding-cells = <0>; wait-ms = <0>; bindings = <&bt BT_SEL 0 &bt BT_CLR>; }; }; }; / { behaviors { u_bt_sel_0: u_bt_sel_0 { compatible = "zmk,behavior-mod-morph"; #binding-cells = <0>; bindings = <&bt BT_SEL 0>, <&u_macro_u_bt_sel_0>; mods = <(MOD_LSFT|MOD_RSFT)>; }; }; };
/ { macros { u_macro_u_bt_sel_1: u_macro_u_bt_sel_1 { compatible = "zmk,behavior-macro"; #binding-cells = <0>; wait-ms = <0>; bindings = <&bt BT_SEL 1 &bt BT_CLR>; }; }; }; / { behaviors { u_bt_sel_1: u_bt_sel_1 { compatible = "zmk,behavior-mod-morph"; #binding-cells = <0>; bindings = <&bt BT_SEL 1>, <&u_macro_u_bt_sel_1>; mods = <(MOD_LSFT|MOD_RSFT)>; }; }; };
/ { macros { u_macro_u_bt_sel_2: u_macro_u_bt_sel_2 { compatible = "zmk,behavior-macro"; #binding-cells = <0>; wait-ms = <0>; bindings = <&bt BT_SEL 2 &bt BT_CLR>; }; }; }; / { behaviors { u_bt_sel_2: u_bt_sel_2 { compatible = "zmk,behavior-mod-morph"; #binding-cells = <0>; bindings = <&bt BT_SEL 2>, <&u_macro_u_bt_sel_2>; mods = <(MOD_LSFT|MOD_RSFT)>; }; }; };
/ { macros { u_macro_u_bt_sel_3: u_macro_u_bt_sel_3 { compatible = "zmk,behavior-macro"; #binding-cells = <0>; wait-ms = <0>; bindings = <&bt BT_SEL 3 &bt BT_CLR>; }; }; }; / { behaviors { u_bt_sel_3: u_bt_sel_3 { compatible = "zmk,behavior-mod-morph"; #binding-cells = <0>; bindings = <&bt BT_SEL 3>, <&u_macro_u_bt_sel_3>; mods = <(MOD_LSFT|MOD_RSFT)>; }; }; };
/ { macros { u_macro_u_bt_sel_4: u_macro_u_bt_sel_4 { compatible = "zmk,behavior-macro"; #binding-cells = <0>; wait-ms = <0>; bindings = <&bt BT_SEL 4 &bt BT_CLR>; }; }; }; / { behaviors { u_bt_sel_4: u_bt_sel_4 { compatible = "zmk,behavior-mod-morph"; #binding-cells = <0>; bindings = <&bt BT_SEL 4>, <&u_macro_u_bt_sel_4>; mods = <(MOD_LSFT|MOD_RSFT)>; }; }; };

/ { behaviors { u_out_tog: u_out_tog { compatible = "zmk,behavior-mod-morph"; #binding-cells = <0>; bindings = <&out OUT_TOG>, <&out OUT_USB>; mods = <(MOD_LSFT|MOD_RSFT)>; }; }; };

/ { behaviors { u_caps_word: u_caps_word { compatible = "zmk,behavior-mod-morph"; #binding-cells = <0>; bindings = <&caps_word>, <&kp CAPS>; mods = <(MOD_LSFT|MOD_RSFT)>; }; }; };
#line 18 "miryoku/miryoku_double_tap_guard.dtsi"
/ { behaviors { u_to_U_BASE: u_to_U_BASE { compatible = "zmk,behavior-tap-dance"; #binding-cells = <0>; tapping-term-ms = <200>; bindings = <&none>, <&to 0>; }; }; }; / { behaviors { u_to_U_EXTRA: u_to_U_EXTRA { compatible = "zmk,behavior-tap-dance"; #binding-cells = <0>; tapping-term-ms = <200>; bindings = <&none>, <&to 1>; }; }; }; / { behaviors { u_to_U_TAP: u_to_U_TAP { compatible = "zmk,behavior-tap-dance"; #binding-cells = <0>; tapping-term-ms = <200>; bindings = <&none>, <&to 2>; }; }; }; / { behaviors { u_to_U_BUTTON: u_to_U_BUTTON { compatible = "zmk,behavior-tap-dance"; #binding-cells = <0>; tapping-term-ms = <200>; bindings = <&none>, <&to 3>; }; }; }; / { behaviors { u_to_U_NAV: u_to_U_NAV { compatible = "zmk,behavior-tap-dance"; #binding-cells = <0>; tapping-term-ms = <200>; bindings = <&none>, <&to 4>; }; }; }; / { behaviors { u_to_U_MOUSE: u_to_U_MOUSE { compatible = "zmk,behavior-tap-dance"; #binding-cells = <0>; tapping-term-ms = <200>; bindings = <&none>, <&to 5>; }; }; }; / { behaviors { u_to_U_MEDIA: u_to_U_MEDIA { compatible = "zmk,behavior-tap-dance"; #binding-cells = <0>; tapping-term-ms = <200>; bindings = <&none>, <&to 6>; }; }; }; / { behaviors { u_to_U_NUM: u_to_U_NUM { compatible = "zmk,behavior-tap-dance"; #binding-cells = <0>; tapping-term-ms = <200>; bindings = <&none>, <&to 7>; }; }; }; / { behaviors { u_to_U_SYM: u_to_U_SYM { compatible = "zmk,behavior-tap-dance"; #binding-cells = <0>; tapping-term-ms = <200>; bindings = <&none>, <&to 8>; }; }; }; / { behaviors { u_to_U_FUN: u_to_U_FUN { compatible = "zmk,behavior-tap-dance"; #binding-cells = <0>; tapping-term-ms = <200>; bindings = <&none>, <&to 9>; }; }; };
#line 4 "miryoku/miryoku_mousekeys.dtsi"
/ { macros { u_macro_btn1: u_macro_btn1 { compatible = "zmk,behavior-macro"; #binding-cells = <0>; wait-ms = <0>; bindings = <&kp KP_SLASH &kp KP_N5>; }; }; };
/ { macros { u_macro_btn2: u_macro_btn2 { compatible = "zmk,behavior-macro"; #binding-cells = <0>; wait-ms = <0>; bindings = <&kp KP_MINUS &kp KP_N5>; }; }; };
/ { macros { u_macro_btn3: u_macro_btn3 { compatible = "zmk,behavior-macro"; #binding-cells = <0>; wait-ms = <0>; bindings = <&kp KP_ASTERISK &kp KP_N5>; }; }; };
#line 4 "miryoku/miryoku_behaviors.dtsi"
/ {
  behaviors {
    u_mt: u_mt {
      compatible = "zmk,behavior-hold-tap";
      #binding-cells = <2>;
      tapping-term-ms = <200>;
      flavor = "tap-preferred";
      bindings = <&kp>, <&kp>;
    };
    u_lt: u_lt {
      compatible = "zmk,behavior-hold-tap";
      #binding-cells = <2>;
      tapping-term-ms = <200>;
      flavor = "tap-preferred";
      bindings = <&mo>, <&kp>;
    };
  };
};
#line 3 "config/mouse_layer.keymap.inc"
&keymap {
  u_mouse {
    bindings = <
      &mkp MB1       &mkp MB2       &mkp MB3       U_BTN4       U_BTN5
      U_MH_LEFT    U_MH_DOWN    U_MH_UP      U_MH_RIGHT   &none
      U_MW_LEFT    U_MW_DOWN    U_MW_UP      U_MW_RIGHT   &none
      &none         &none         &none         &none         &none
      &none         &none         &none         &none         &none
      &none         &none         &none
      &none         &none         &none
      &none         &none         &none
    >;
  };
};
